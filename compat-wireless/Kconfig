## compat-wireless/Kconfig
```kconfig
config COMPAT_WIRELESS
        tristate "COMPAT WIRELESS support"
	depends on WLAN
        help
	  Compat wireless support for Eink devices

config COMPAT_WIRELESS_MODULES
        tristate "COMPAT WIRELESS module support"
	depends on MMC
        help
	  Compat wireless module support for Eink devices

source compat-wireless/compat/Kconfig
source compat-wireless/drivers/net/wireless/ath/Kconfig
```

## compat-wireless/compat/Kconfig
```kconfig
config COMPAT_KERNEL_3_0
        tristate "COMPAT kernel 3.0 support"
	help
	  Compatibility kernel 3.0 support
```

## drivers/falcon/Kconfig
```kconfig
#
# Falcon device driver configuration
#

menuconfig FALCON_DRV
	bool "Falcon device driver"
	depends on FALCON
	default n
	---help---
	  Say Y here to get to see options for various different falcon wrapper drivers.
	  This option alone does not add any kernel code.

	  If you say N, all options in this submenu will be skipped and disabled;
	  only do this if you know what you are doing.

if FALCON_DRV

config FALCON_WRAPPER
	bool "Falcon wrapper drivers"
	default n

config FALCON_BLK
	tristate "Falcon Block Storage Driver support"
	default n
	depends on FALCON_WRAPPER && BLK_DEV
	help
	  This enables the Block storage driver for Falcon.

config FALCON_BLK_BOOTPART
	bool "BootPartion support"
	default n
	depends on FALCON_BLK
	help
	  This enables BootPartion for the Block storage driver.

config FALCON_BLK_MULTISEG
	bool "Use multi segments transfer"
	default y
	depends on FALCON_BLK
	help
	  Say Y here to use Bounce Buffer capability.

config FALCON_MTD_NAND
	tristate "Falcon NAND Driver support"
	default n
	depends on FALCON_WRAPPER && MTD_NAND
	help
	  This enables the NAND storage driver for Falcon.

endif # FALCON_DRV
```

## drivers/input/misc/smtc/Kconfig
```kconfig
# Semtech Capacitive Touch Button driver configuration
menu "Semtech Cap Touch"

config INPUT_SX9500
	tristate "SX9500 based capacitive touch button"
	depends on I2C
	help
	  Say Y here if you have a SX9500.

	  If unsure, say N.

	  To compile this driver as a module, choose M here: the
	  module will be called sx8651.

endmenu
```
